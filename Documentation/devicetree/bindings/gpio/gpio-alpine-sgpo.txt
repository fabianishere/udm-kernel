## arch/arm64/configs/alpine_defconfig
```kconfig
# CONFIG_LOCALVERSION_AUTO is not set
CONFIG_SYSVIPC=y
CONFIG_FHANDLE=y
CONFIG_NO_HZ=y
CONFIG_HIGH_RES_TIMERS=y
CONFIG_IKCONFIG=y
CONFIG_IKCONFIG_PROC=y
CONFIG_CGROUPS=y
CONFIG_USER_NS=y
CONFIG_BLK_DEV_INITRD=y
CONFIG_PROFILING=y
CONFIG_MODULES=y
CONFIG_MODULE_UNLOAD=y
CONFIG_BLK_DEV_INTEGRITY=y
CONFIG_PARTITION_ADVANCED=y
CONFIG_LDM_PARTITION=y
CONFIG_ARCH_VEXPRESS=y
CONFIG_ARCH_ALPINE=y
CONFIG_PCI_IOV=y
CONFIG_PCI_INTERNAL_ALPINE=y
CONFIG_PCI_EXTERNAL_ALPINE=y
CONFIG_SMP=y
CONFIG_NR_CPUS=4
CONFIG_TRANSPARENT_HUGEPAGE=y
CONFIG_CPU_IDLE=y
CONFIG_ARM_CPUIDLE=y
CONFIG_NET=y
CONFIG_PACKET=y
CONFIG_UNIX=y
CONFIG_XFRM_USER=y
CONFIG_NET_KEY=y
CONFIG_INET=y
CONFIG_IP_MULTICAST=y
CONFIG_IP_PNP=y
CONFIG_IP_PNP_BOOTP=y
CONFIG_INET_AH=y
CONFIG_INET_ESP=y
# CONFIG_INET_DIAG is not set
# CONFIG_IPV6 is not set
CONFIG_BRIDGE=y
CONFIG_DEVTMPFS=y
CONFIG_DEVTMPFS_MOUNT=y
CONFIG_MTD=y
CONFIG_MTD_M25P80=y
CONFIG_MTD_NAND=y
CONFIG_MTD_NAND_AL=y
CONFIG_MTD_SPI_NOR=y
CONFIG_MTD_UBI=y
CONFIG_BLK_DEV_NVME=y
CONFIG_EEPROM_AT24=y
CONFIG_RAID_ATTRS=y
CONFIG_BLK_DEV_SD=y
CONFIG_SCSI_SAS_ATTRS=y
CONFIG_SCSI_MPT2SAS=m
CONFIG_ATA=y
# CONFIG_SATA_PMP is not set
CONFIG_SATA_AHCI=y
CONFIG_SATA_AHCI_PLATFORM=y
CONFIG_SATA_SIL24=m
CONFIG_MD=y
CONFIG_BLK_DEV_MD=y
CONFIG_MD_RAID0=y
CONFIG_MD_RAID1=y
CONFIG_MD_RAID10=y
CONFIG_MD_RAID456=y
CONFIG_BLK_DEV_DM=y
CONFIG_DM_CRYPT=y
CONFIG_TARGET_CORE=m
CONFIG_ISCSI_TARGET=m
CONFIG_NETDEVICES=y
CONFIG_BONDING=m
CONFIG_NET_TEAM=m
CONFIG_NET_TEAM_MODE_BROADCAST=m
CONFIG_NET_TEAM_MODE_ROUNDROBIN=m
CONFIG_NET_TEAM_MODE_RANDOM=m
CONFIG_NET_TEAM_MODE_ACTIVEBACKUP=m
CONFIG_NET_TEAM_MODE_LOADBALANCE=m
CONFIG_NET_AL_ETH=y
CONFIG_E100=m
CONFIG_E1000=m
CONFIG_E1000E=m
CONFIG_IGB=m
CONFIG_IGBVF=m
CONFIG_IXGBE=m
CONFIG_IXGBEVF=m
CONFIG_AT803X_PHY=y
CONFIG_INPUT_EVDEV=y
# CONFIG_SERIO_SERPORT is not set
CONFIG_SERIO_AMBAKMI=y
CONFIG_LEGACY_PTY_COUNT=16
CONFIG_AL_TRACE=y
CONFIG_SERIAL_8250=y
CONFIG_SERIAL_8250_CONSOLE=y
CONFIG_SERIAL_8250_EXTENDED=y
CONFIG_SERIAL_8250_MANY_PORTS=y
CONFIG_SERIAL_8250_SHARE_IRQ=y
CONFIG_SERIAL_8250_RSA=y
CONFIG_SERIAL_8250_DW=y
CONFIG_SERIAL_OF_PLATFORM=y
CONFIG_HW_RANDOM=y
CONFIG_I2C=y
CONFIG_I2C_CHARDEV=y
CONFIG_I2C_MUX=y
CONFIG_I2C_MUX_PCA954x=y
CONFIG_I2C_DESIGNWARE_PLATFORM=y
CONFIG_SPI=y
CONFIG_SPI_DESIGNWARE=y
CONFIG_SPI_DW_MMIO=y
CONFIG_GPIO_SYSFS=y
CONFIG_GPIO_PL061=y
CONFIG_GPIO_AL_SGPO=y
CONFIG_GPIO_PCA953X=y
CONFIG_GPIO_PCA953X_IRQ=y
# CONFIG_HWMON is not set
CONFIG_THERMAL=y
CONFIG_AL_THERMAL=y
CONFIG_USB=y
CONFIG_USB_XHCI_HCD=y
CONFIG_USB_EHCI_HCD=y
CONFIG_USB_EHCI_HCD_PLATFORM=y
CONFIG_USB_OHCI_HCD=y
CONFIG_USB_UHCI_HCD=y
CONFIG_USB_STORAGE=y
CONFIG_USB_SERIAL=y
CONFIG_USB_SERIAL_CP210X=y
CONFIG_EDAC=y
CONFIG_EDAC_MM_EDAC=y
CONFIG_EDAC_AL_MC=y
CONFIG_DMADEVICES=y
CONFIG_ASYNC_TX_DMA=y
CONFIG_AL_DMA=y
CONFIG_AL_DMA_STATS=y
CONFIG_AL_DMA_PCI_IOV=y
CONFIG_UIO=y
# CONFIG_IOMMU_SUPPORT is not set
CONFIG_AL_TDM_TEST_MODULE=m
CONFIG_MEMORY=y
CONFIG_EXT2_FS=y
CONFIG_EXT3_FS=y
CONFIG_EXT4_FS=y
CONFIG_XFS_FS=y
CONFIG_BTRFS_FS=y
CONFIG_VFAT_FS=y
CONFIG_TMPFS=y
CONFIG_TMPFS_POSIX_ACL=y
CONFIG_HUGETLBFS=y
CONFIG_CONFIGFS_FS=y
CONFIG_ECRYPT_FS=y
CONFIG_UBIFS_FS=y
CONFIG_NFS_FS=y
CONFIG_ROOT_NFS=y
CONFIG_NFSD=y
CONFIG_NFSD_V3=y
CONFIG_NLS_CODEPAGE_850=y
CONFIG_NLS_ISO8859_1=y
CONFIG_PRINTK_TIME=y
CONFIG_MESSAGE_LOGLEVEL_DEFAULT=7
CONFIG_DEBUG_INFO=y
CONFIG_MAGIC_SYSRQ=y
CONFIG_DEBUG_KERNEL=y
CONFIG_ENABLE_DEFAULT_TRACERS=y
CONFIG_KEYS=y
CONFIG_ENCRYPTED_KEYS=y
# CONFIG_CRYPTO_MANAGER_DISABLE_TESTS is not set
CONFIG_CRYPTO_CMAC=y
CONFIG_CRYPTO_MD4=y
CONFIG_CRYPTO_ARC4=y
CONFIG_CRYPTO_DEV_AL_CRYPTO=y
CONFIG_CRYPTO_DEV_AL_CRYPTO_STATS=y
CONFIG_RTC_LIB=y
CONFIG_RTC_CLASS=y
CONFIG_RTC_DRV_DS1307=y
CONFIG_LOCALVERSION="-6.1.3-5851039"
```

## arch/arm64/configs/alpine_na_defconfig
```kconfig
# CONFIG_LOCALVERSION_AUTO is not set
CONFIG_SYSVIPC=y
CONFIG_FHANDLE=y
CONFIG_NO_HZ=y
CONFIG_HIGH_RES_TIMERS=y
CONFIG_IKCONFIG=y
CONFIG_IKCONFIG_PROC=y
# CONFIG_CGROUPS is not set
# CONFIG_USER_NS is not set
CONFIG_BLK_DEV_INITRD=y
# CONFIG_PROFILING is not set
CONFIG_MODULES=y
CONFIG_MODULE_UNLOAD=y
CONFIG_BLK_DEV_INTEGRITY=y
CONFIG_PARTITION_ADVANCED=y
CONFIG_LDM_PARTITION=y
CONFIG_ARCH_VEXPRESS=y
CONFIG_ARCH_ALPINE=y
CONFIG_PCI_IOV=y
CONFIG_PCI_INTERNAL_ALPINE=y
CONFIG_PCI_EXTERNAL_ALPINE=y
CONFIG_SMP=y
CONFIG_NR_CPUS=4
CONFIG_TRANSPARENT_HUGEPAGE=y
CONFIG_CPU_IDLE=y
# CONFIG_ARM_CPUIDLE is not set
CONFIG_NET=y
CONFIG_PACKET=y
CONFIG_UNIX=y
# CONFIG_XFRM_USER is not set
CONFIG_NET_KEY=y
CONFIG_INET=y
CONFIG_IP_MULTICAST=y
CONFIG_IP_PNP=y
CONFIG_IP_PNP_BOOTP=y
CONFIG_INET_AH=y
CONFIG_INET_ESP=y
# CONFIG_INET_DIAG is not set
# CONFIG_IPV6 is not set
CONFIG_BRIDGE=y
CONFIG_DEVTMPFS=y
CONFIG_DEVTMPFS_MOUNT=y
CONFIG_MTD=y
CONFIG_MTD_M25P80=y
CONFIG_MTD_NAND=y
CONFIG_MTD_NAND_AL=y
CONFIG_MTD_SPI_NOR=y
CONFIG_MTD_UBI=y
CONFIG_BLK_DEV_NVME=y
CONFIG_EEPROM_AT24=y
CONFIG_RAID_ATTRS=y
CONFIG_BLK_DEV_SD=y
CONFIG_SCSI_SAS_ATTRS=y
CONFIG_SCSI_MPT2SAS=m
CONFIG_ATA=y
# CONFIG_SATA_PMP is not set
CONFIG_SATA_AHCI=y
CONFIG_SATA_AHCI_PLATFORM=y
CONFIG_SATA_SIL24=m
CONFIG_MD=y
CONFIG_BLK_DEV_MD=y
CONFIG_MD_RAID0=y
CONFIG_MD_RAID1=y
CONFIG_MD_RAID10=y
CONFIG_MD_RAID456=y
CONFIG_BLK_DEV_DM=y
CONFIG_DM_CRYPT=y
CONFIG_TARGET_CORE=m
CONFIG_ISCSI_TARGET=m
CONFIG_NETDEVICES=y
CONFIG_BONDING=m
CONFIG_NET_TEAM=m
CONFIG_NET_TEAM_MODE_BROADCAST=m
CONFIG_NET_TEAM_MODE_ROUNDROBIN=m
CONFIG_NET_TEAM_MODE_RANDOM=m
CONFIG_NET_TEAM_MODE_ACTIVEBACKUP=m
CONFIG_NET_TEAM_MODE_LOADBALANCE=m
CONFIG_NET_AL_ETH=y
CONFIG_E100=m
CONFIG_E1000=m
CONFIG_E1000E=m
CONFIG_IGB=m
CONFIG_IGBVF=m
CONFIG_IXGBE=m
CONFIG_IXGBEVF=m
CONFIG_AT803X_PHY=y
CONFIG_INPUT_EVDEV=y
# CONFIG_SERIO_SERPORT is not set
CONFIG_SERIO_AMBAKMI=y
CONFIG_LEGACY_PTY_COUNT=16
# CONFIG_AL_TRACE is not set
CONFIG_SERIAL_8250=y
CONFIG_SERIAL_8250_CONSOLE=y
CONFIG_SERIAL_8250_EXTENDED=y
CONFIG_SERIAL_8250_MANY_PORTS=y
CONFIG_SERIAL_8250_SHARE_IRQ=y
CONFIG_SERIAL_8250_RSA=y
CONFIG_SERIAL_8250_DW=y
CONFIG_SERIAL_OF_PLATFORM=y
CONFIG_HW_RANDOM=y
CONFIG_I2C=y
CONFIG_I2C_CHARDEV=y
CONFIG_I2C_MUX=y
CONFIG_I2C_MUX_PCA954x=y
CONFIG_I2C_DESIGNWARE_PLATFORM=y
CONFIG_SPI=y
CONFIG_SPI_DESIGNWARE=y
CONFIG_SPI_DW_MMIO=y
CONFIG_GPIO_SYSFS=y
CONFIG_GPIO_PL061=y
CONFIG_GPIO_AL_SGPO=y
CONFIG_GPIO_PCA953X=y
CONFIG_GPIO_PCA953X_IRQ=y
# CONFIG_HWMON is not set
CONFIG_THERMAL=y
CONFIG_AL_THERMAL=y
CONFIG_USB=y
CONFIG_USB_XHCI_HCD=y
CONFIG_USB_EHCI_HCD=y
CONFIG_USB_EHCI_HCD_PLATFORM=y
CONFIG_USB_OHCI_HCD=y
CONFIG_USB_UHCI_HCD=y
CONFIG_USB_STORAGE=y
CONFIG_USB_SERIAL=y
CONFIG_USB_SERIAL_CP210X=y
CONFIG_EDAC=y
CONFIG_EDAC_MM_EDAC=y
CONFIG_EDAC_AL_MC=y
CONFIG_DMADEVICES=y
CONFIG_ASYNC_TX_DMA=y
CONFIG_AL_DMA=y
CONFIG_AL_DMA_STATS=y
CONFIG_AL_DMA_PCI_IOV=y
CONFIG_UIO=y
# CONFIG_IOMMU_SUPPORT is not set
CONFIG_AL_TDM_TEST_MODULE=m
CONFIG_MEMORY=y
CONFIG_EXT2_FS=y
CONFIG_EXT3_FS=y
CONFIG_EXT4_FS=y
CONFIG_XFS_FS=y
CONFIG_BTRFS_FS=y
CONFIG_VFAT_FS=y
CONFIG_TMPFS=y
CONFIG_TMPFS_POSIX_ACL=y
CONFIG_HUGETLBFS=y
CONFIG_CONFIGFS_FS=y
CONFIG_ECRYPT_FS=y
CONFIG_UBIFS_FS=y
CONFIG_NFS_FS=y
CONFIG_ROOT_NFS=y
CONFIG_NFSD=y
CONFIG_NFSD_V3=y
CONFIG_NLS_CODEPAGE_850=y
CONFIG_NLS_ISO8859_1=y
# CONFIG_PRINTK_TIME is not set
CONFIG_MESSAGE_LOGLEVEL_DEFAULT=7
# CONFIG_DEBUG_INFO is not set
CONFIG_MAGIC_SYSRQ=y
# CONFIG_DEBUG_KERNEL is not set
# CONFIG_ENABLE_DEFAULT_TRACERS is not set
CONFIG_KEYS=y
CONFIG_ENCRYPTED_KEYS=y
# CONFIG_CRYPTO_MANAGER_DISABLE_TESTS is not set
# CONFIG_CRYPTO_CMAC is not set
# CONFIG_CRYPTO_MD4 is not set
# CONFIG_CRYPTO_ARC4 is not set
CONFIG_CRYPTO_DEV_AL_CRYPTO=y
CONFIG_CRYPTO_DEV_AL_CRYPTO_STATS=y
CONFIG_RTC_LIB=y
CONFIG_RTC_CLASS=y
CONFIG_RTC_DRV_DS1307=y
CONFIG_LOCALVERSION="-6.1.3-5851039_na"
CONFIG_EXPERT=y
CONFIG_SYSCTL_SYSCALL=y
CONFIG_PERF_EVENTS=y
CONFIG_JUMP_LABEL=y
CONFIG_FUNC_REORDER=y
CONFIG_TRANSPARENT_HUGEPAGE_MADVISE=y
# CONFIG_BQL is not set
# CONFIG_NET_FLOW_LIMIT is not set
CONFIG_NETFILTER=y
CONFIG_NF_CONNTRACK=m
CONFIG_NF_CONNTRACK_EVENTS=y
CONFIG_NF_CONNTRACK_FTP=m
CONFIG_NF_CONNTRACK_SIP=m
CONFIG_NF_CT_NETLINK=m
CONFIG_NF_CT_NETLINK_TIMEOUT=m
CONFIG_NF_CONNTRACK_IPV4=m
CONFIG_NF_NAT_IPV4=m
CONFIG_NF_NAT_MASQUERADE_IPV4=m
CONFIG_IP_NF_IPTABLES=m
CONFIG_IP_NF_FILTER=m
CONFIG_BRIDGE_NF_EBTABLES=m
CONFIG_BRIDGE_EBT_BROUTE=m
CONFIG_BRIDGE_EBT_T_FILTER=m
CONFIG_BRIDGE_EBT_T_NAT=m
CONFIG_BRIDGE_EBT_802_3=m
CONFIG_BRIDGE_EBT_AMONG=m
CONFIG_BRIDGE_EBT_ARP=m
CONFIG_BRIDGE_EBT_IP=m
CONFIG_BRIDGE_EBT_LIMIT=m
CONFIG_BRIDGE_EBT_MARK=m
CONFIG_BRIDGE_EBT_PKTTYPE=m
CONFIG_BRIDGE_EBT_STP=m
CONFIG_BRIDGE_EBT_VLAN=m
CONFIG_BRIDGE_EBT_ARPREPLY=m
CONFIG_BRIDGE_EBT_DNAT=m
CONFIG_BRIDGE_EBT_MARK_T=m
CONFIG_BRIDGE_EBT_REDIRECT=m
CONFIG_BRIDGE_EBT_SNAT=m
CONFIG_BRIDGE_EBT_LOG=m
CONFIG_BRIDGE_EBT_NFLOG=m
CONFIG_VLAN_8021Q=y
CONFIG_NET_MQ_TX_LOCK_OPT=y
```

## arch/arm64/configs/alpine_ubnt_defconfig
```kconfig
# CONFIG_LOCALVERSION_AUTO is not set
CONFIG_SYSVIPC=y
CONFIG_FHANDLE=y
CONFIG_NO_HZ=y
CONFIG_HIGH_RES_TIMERS=y
CONFIG_IKCONFIG=y
CONFIG_IKCONFIG_PROC=y
CONFIG_CGROUPS=y
CONFIG_USER_NS=y
CONFIG_BLK_DEV_INITRD=y
CONFIG_PROFILING=y
CONFIG_MODULES=y
CONFIG_MODULE_UNLOAD=y
CONFIG_BLK_DEV_INTEGRITY=y
CONFIG_PARTITION_ADVANCED=y
CONFIG_LDM_PARTITION=y
CONFIG_ARCH_VEXPRESS=y
CONFIG_ARCH_ALPINE=y
CONFIG_PCI_IOV=y
CONFIG_PCI_INTERNAL_ALPINE=y
CONFIG_PCI_EXTERNAL_ALPINE=y
CONFIG_SMP=y
CONFIG_NR_CPUS=4
CONFIG_TRANSPARENT_HUGEPAGE=y
CONFIG_CPU_IDLE=y
CONFIG_ARM_CPUIDLE=y
CONFIG_NET=y
CONFIG_PACKET=y
CONFIG_UNIX=y
CONFIG_XFRM_USER=y
CONFIG_NET_KEY=y
CONFIG_INET=y
CONFIG_IP_MULTICAST=y
CONFIG_IP_PNP=y
CONFIG_IP_PNP_BOOTP=y
CONFIG_INET_AH=y
CONFIG_INET_ESP=y
# CONFIG_INET_DIAG is not set
# CONFIG_IPV6 is not set
CONFIG_BRIDGE=y
CONFIG_DEVTMPFS=y
CONFIG_DEVTMPFS_MOUNT=y
CONFIG_MTD=y
CONFIG_MTD_M25P80=y
CONFIG_MTD_NAND=y
CONFIG_MTD_NAND_AL=y
CONFIG_MTD_SPI_NOR=y
CONFIG_MTD_UBI=y
CONFIG_BLK_DEV_NVME=y
CONFIG_EEPROM_AT24=y
CONFIG_RAID_ATTRS=y
CONFIG_BLK_DEV_SD=y
CONFIG_SCSI_SAS_ATTRS=y
CONFIG_SCSI_MPT2SAS=m
CONFIG_ATA=y
# CONFIG_SATA_PMP is not set
CONFIG_SATA_AHCI=y
CONFIG_SATA_AHCI_PLATFORM=y
CONFIG_SATA_SIL24=m
CONFIG_MD=y
CONFIG_BLK_DEV_MD=y
CONFIG_MD_RAID0=y
CONFIG_MD_RAID1=y
CONFIG_MD_RAID10=y
CONFIG_MD_RAID456=y
CONFIG_BLK_DEV_DM=y
CONFIG_DM_CRYPT=y
CONFIG_TARGET_CORE=m
CONFIG_ISCSI_TARGET=m
CONFIG_NETDEVICES=y
CONFIG_BONDING=m
CONFIG_NET_TEAM=m
CONFIG_NET_TEAM_MODE_BROADCAST=m
CONFIG_NET_TEAM_MODE_ROUNDROBIN=m
CONFIG_NET_TEAM_MODE_RANDOM=m
CONFIG_NET_TEAM_MODE_ACTIVEBACKUP=m
CONFIG_NET_TEAM_MODE_LOADBALANCE=m
CONFIG_NET_AL_ETH=y
CONFIG_E100=m
CONFIG_E1000=m
CONFIG_E1000E=m
CONFIG_IGB=m
CONFIG_IGBVF=m
CONFIG_IXGBE=m
CONFIG_IXGBEVF=m
CONFIG_AT803X_PHY=y
CONFIG_INPUT_EVDEV=y
# CONFIG_SERIO_SERPORT is not set
CONFIG_SERIO_AMBAKMI=y
CONFIG_LEGACY_PTY_COUNT=16
CONFIG_AL_TRACE=y
CONFIG_SERIAL_8250=y
CONFIG_SERIAL_8250_CONSOLE=y
CONFIG_SERIAL_8250_EXTENDED=y
CONFIG_SERIAL_8250_MANY_PORTS=y
CONFIG_SERIAL_8250_SHARE_IRQ=y
CONFIG_SERIAL_8250_RSA=y
CONFIG_SERIAL_8250_DW=y
CONFIG_SERIAL_OF_PLATFORM=y
CONFIG_HW_RANDOM=y
CONFIG_I2C=y
CONFIG_I2C_CHARDEV=y
CONFIG_I2C_MUX=y
CONFIG_I2C_MUX_PCA954x=y
CONFIG_I2C_DESIGNWARE_PLATFORM=y
CONFIG_SPI=y
CONFIG_SPI_DESIGNWARE=y
CONFIG_SPI_DW_MMIO=y
CONFIG_GPIO_SYSFS=y
CONFIG_GPIO_PL061=y
CONFIG_GPIO_AL_SGPO=y
CONFIG_GPIO_PCA953X=y
CONFIG_GPIO_PCA953X_IRQ=y
# CONFIG_HWMON is not set
CONFIG_THERMAL=y
CONFIG_AL_THERMAL=y
CONFIG_USB=y
CONFIG_USB_XHCI_HCD=y
CONFIG_USB_XHCI_PCI=y
CONFIG_USB_EHCI_HCD=y
CONFIG_USB_EHCI_HCD_PLATFORM=y
CONFIG_USB_OHCI_HCD=y
CONFIG_USB_UHCI_HCD=y
CONFIG_USB_STORAGE=y
CONFIG_USB_SERIAL=y
CONFIG_USB_SERIAL_CP210X=y
CONFIG_EDAC=y
CONFIG_EDAC_MM_EDAC=y
CONFIG_EDAC_AL_MC=y
CONFIG_DMADEVICES=y
CONFIG_ASYNC_TX_DMA=y
CONFIG_AL_DMA=y
CONFIG_AL_DMA_STATS=y
CONFIG_AL_DMA_PCI_IOV=y
CONFIG_UIO=y
# CONFIG_IOMMU_SUPPORT is not set
CONFIG_AL_TDM_TEST_MODULE=m
CONFIG_MEMORY=y
CONFIG_EXT2_FS=y
CONFIG_EXT3_FS=y
CONFIG_EXT4_FS=y
CONFIG_XFS_FS=y
CONFIG_BTRFS_FS=y
CONFIG_VFAT_FS=y
CONFIG_TMPFS=y
CONFIG_TMPFS_POSIX_ACL=y
CONFIG_HUGETLBFS=y
CONFIG_CONFIGFS_FS=y
CONFIG_ECRYPT_FS=y
CONFIG_UBIFS_FS=y
CONFIG_NFS_FS=y
CONFIG_ROOT_NFS=y
CONFIG_NFSD=y
CONFIG_NFSD_V3=y
CONFIG_NLS_CODEPAGE_850=y
CONFIG_NLS_ISO8859_1=y
CONFIG_PRINTK_TIME=y
CONFIG_MESSAGE_LOGLEVEL_DEFAULT=7
CONFIG_DEBUG_INFO=y
CONFIG_MAGIC_SYSRQ=y
CONFIG_DEBUG_KERNEL=y
CONFIG_ENABLE_DEFAULT_TRACERS=y
CONFIG_KEYS=y
CONFIG_ENCRYPTED_KEYS=y
# CONFIG_CRYPTO_MANAGER_DISABLE_TESTS is not set
CONFIG_CRYPTO_CMAC=y
CONFIG_CRYPTO_MD4=y
CONFIG_CRYPTO_ARC4=y
CONFIG_CRYPTO_DEV_AL_CRYPTO=y
CONFIG_CRYPTO_DEV_AL_CRYPTO_STATS=y
CONFIG_RTC_LIB=y
CONFIG_RTC_CLASS=y
CONFIG_RTC_DRV_DS1307=y
CONFIG_LOCALVERSION="-6.1.3-5851039"
CONFIG_SOUND=y
CONFIG_SND=y
CONFIG_SND_DRIVERS=y
CONFIG_SND_USB=y
CONFIG_SND_USB_AUDIO=y
# USB Device Class drivers
CONFIG_USB_ACM=y
CONFIG_INPUT_KEYBOARD=y
CONFIG_KEYBOARD_GPIO=y

CONFIG_WIRELESS=y
CONFIG_WIRELESS_EXT=y
CONFIG_WEXT_CORE=y
CONFIG_WEXT_PROC=y
CONFIG_WEXT_SPY=y
CONFIG_WEXT_PRIV=y
CONFIG_CFG80211=y
CONFIG_CFG80211_DEFAULT_PS=y
CONFIG_CFG80211_WEXT=y

CONFIG_WIFI_DRIVER=y
CONFIG_FIRST_IF_MT7603E=y
CONFIG_SECOND_IF_MT7615E=y
CONFIG_THIRD_IF_NONE=y
CONFIG_RT_FIRST_CARD="7603e"
CONFIG_RT_SECOND_CARD="7615e"
CONFIG_RT_FIRST_IF_RF_OFFSET=0x0
CONFIG_RT_SECOND_IF_RF_OFFSET=0x8000
CONFIG_MT_WIFI=y
CONFIG_MT_WIFI_PATH="mt_wifi"
CONFIG_FIRST_IF_EEPROM_EFUSE=y
CONFIG_RT_FIRST_CARD_EEPROM="efuse"
# CONFIG_SECOND_IF_EEPROM_FLASH is not set
CONFIG_SECOND_IF_EEPROM_FLASH=y
CONFIG_RT_SECOND_CARD_EEPROM="flash"
CONFIG_MULTI_INF_SUPPORT=y
CONFIG_WIFI_BASIC_FUNC=y
CONFIG_DOT11_N_SUPPORT=y
CONFIG_DOT11_VHT_AC=y
CONFIG_G_BAND_256QAM_SUPPORT=y
CONFIG_TPC_SUPPORT=y
CONFIG_MT_DFS_SUPPORT=y
CONFIG_HDR_TRANS_TX_SUPPORT=y
CONFIG_HDR_TRANS_RX_SUPPORT=y
CONFIG_WSC_INCLUDED=y
CONFIG_WSC_V2_SUPPORT=y
CONFIG_DOT11W_PMF_SUPPORT=y
CONFIG_TXBF_SUPPORT=y
CONFIG_IGMP_SNOOP_SUPPORT=y
CONFIG_RTMP_FLASH_SUPPORT=y
CONFIG_ATE_SUPPORT=y
CONFIG_UAPSD=y
CONFIG_RED_SUPPORT=y
CONFIG_FIRST_IF_IPAILNA=y
CONFIG_SECOND_IF_IPAILNA=y
CONFIG_WIFI_MODE_AP=m
CONFIG_MT_AP_SUPPORT=y
CONFIG_MBSS_SUPPORT=y
CONFIG_APCLI_SUPPORT=y
CONFIG_APCLI_CERT_SUPPORT=y
CONFIG_MAC_REPEATER_SUPPORT=y
CONFIG_MUMIMO_SUPPORT=y
CONFIG_MU_RA_SUPPORT=y
CONFIG_MCAST_RATE_SPECIFIC=y
# CONFIG_LED_CONTROL_SUPPORT is not set
CONFIG_GREENAP_SUPPORT=y
CONFIG_MT_MAC=y
CONFIG_CHIP_MT7615E=y
CONFIG_MT7603E_RLT_WIFI=m
CONFIG_MT7603E_FIRST_IF_EEPROM_EFUSE=y
CONFIG_MT7603E_RT_FIRST_CARD_EEPROM
CONFIG_MT7603E_RLT_AP_SUPPORT=y
CONFIG_MT_WIFI_PATH="rlt_wifi"
CONFIG_DOT11N_DRAFT3=y
CONFIG_DOT11W_PMF_SUPPORT=y
CONFIG_RATE_ADAPTION=y
CONFIG_NEW_RATE_ADAPT_SUPPORT=y
CONFIG_SMART_CARRIER_SENSE_SUPPORT=y
CONFIG_RT2860V2_AP_V24_DATA_STRUCTURE=y
CONFIG_RTMP_PCI_SUPPORT=y
CONFIG_MBSS_SUPPORT=y
CONFIG_ICAP_SUPPORT=y
CONFIG_SPECTRUM_SUPPORT=y
CONFIG_BACKGROUND_SCAN_SUPPORT=y
CONFIG_DBDC_MODE=y
CONFIG_RLM_CAL_CACHE_SUPPORT=y
CONFIG_VOW_SUPPORT=y
CONFIG_BAND_STEERING=y
CONFIG_PCIE_ASPM_DYM_CTRL_SUPPORT=y
CONFIG_WIFI_MT_MAC=y
CONFIG_APCLI_SUPPORT=y
CONFIG_MULTI_APCLI_SUPPORT=y
CONFIG_RALINK_MT7603E=y
# CONFIG_MT7603E_WAPI_SUPPORT is not set
CONFIG_CUSTOM_MT_FILE_PATH=y
CONFIG_MT_EEPROM_FILE_PATH="/etc_ro/Wireless/ra0/"
CONFIG_MT_AP_PROFILE_PATH="/etc/Wireless/ra0/MT7615_AP.dat"
CONFIG_MT_STA_PROFILE_PATH="/etc/Wireless/ra0/MT7615_STA.dat"
CONFIG_CUSTOM_RLT_FILE_PATH=y
CONFIG_RLT_EEPROM_FILE_PATH="/etc_ro/Wireless/ra1/"
CONFIG_RLT_AP_PROFILE_PATH="/etc/Wireless/ra1/MT7603_AP.dat"
CONFIG_TTY=y
CONFIG_BT=y
CONFIG_BT_BNEP=y
CONFIG_BT_HCIUART=y
CONFIG_BT_HIDP=y
CONFIG_BT_RFCOMM=y
CONFIG_BT_HCIUART_BCSP=y
CONFIG_BT_HCIUART_H4=y
CONFIG_SPI_SPIDEV=y
CONFIG_POE_BCM59111=y
CONFIG_WIFI_MTD=y
CONFIG_HWMON=y
CONFIG_SENSORS_LM63=y
CONFIG_NEW_LEDS=y
CONFIG_LEDS_CLASS=y
CONFIG_LEDS_GPIO=y
CONFIG_SENSORS_ADT7475=y
CONFIG_FB=y
CONFIG_FB_SSD1307=y
```

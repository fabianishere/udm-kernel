## Documentation/devicetree/bindings/gpio/gpio-alpine-sgpo.txt
```
* Serial General Purpose Output (SGPO) bus.

Properties:
- compatible: "al,alpine-sgpo"

- reg: The base address of the SGPO unit's register bank.

- gpio-controller: This is a GPIO controller.

- #gpio-cells: Must be <2>.  The first cell is the GPIO pin.

Example:
	sgpo: sgpo {
		#gpio-cells = <2>;
		compatible = "al,alpine-sgpo";
		gpio-controller;
		reg = <0x0 0xfd8b4000 0x0 0x5000>;
	};
```

## Documentation/devicetree/bindings/gpio/pl061-gpio.txt
```
ARM PL061 GPIO controller

Required properties:
- compatible : "arm,pl061", "arm,primecell"
- #gpio-cells : Should be two. The first cell is the pin number and the
  second cell is used to specify optional parameters:
  - bit 0 specifies polarity (0 for normal, 1 for inverted)
- gpio-controller : Marks the device node as a GPIO controller.
- interrupts : Interrupt mapping for GPIO IRQ.
- gpio-ranges : Interaction with the PINCTRL subsystem.
- baseidx : base index for the GPIO numeration.

Example of gpio-controller nodes:
	gpio0 {
		#gpio-cells = <2>;
		compatible = "arm,pl061", "arm,primecell";
		gpio-controller;
		reg = <0x0 0xfd887000 0x0 0x1000>;
		interrupts = <0 2 4>;
		clocks = <&sbclk>;
		clock-names = "apb_pclk";
		baseidx = <0>;
	};

	gpio1 {
		#gpio-cells = <2>;
		compatible = "arm,pl061", "arm,primecell";
		gpio-controller;
		reg = <0x0 0xfd888000 0x0 0x1000>;
		interrupts = <0 3 4>;
		clocks = <&sbclk>;
		clock-names = "apb_pclk";
		baseidx = <8>;
	};
```

## Documentation/devicetree/bindings/interrupt-controller/al,alpine-iofic.txt
```
Alpine IOFIC interrupt controller

This interrupt controller hardware is a second level interrupt controller that
is hooked to a parent interrupt controller: e.g: ARM GIC for ARM-based
platforms.

Required properties:

- compatible: should be "al,alpine-iofic"
- reg: physical base address and size of the registers
- interrupt-controller: identifies the node as an interrupt controller
- interrupt-parent: specifies the parent interrupt controller.
- interrupts-in: number of interrupts connected to this iofic
- interrupt-parent: the phandle to the parent interrupt controller

Example:

	pbs_iofic: pbs_iofic {
		#interrupt-cells = <1>;
		compatible = "al,alpine-iofic";
		reg = <0x0 0xfd8a8500 0x0 0x100000>;
		interrupt-controller;
		interrupts-in = <27>;
		interrupts = <0x0 0x0 0x4>;
		interrupt-parent = <&gic_main>;
	};
```

## Documentation/devicetree/bindings/pci/amazon-pcie-err.txt
```
Amazon PCIe Error Events driver

The PCIe error events driver detect two types of errors, AXI and APP.
AXI: Errors between the AXI bus and PCIEe.
APP: Errors in the upper layer of the controller (alpine layer).

This driver run in polling mode and collect all events for both AXI and
APP types. Panic (optional - controlled by device-tree and sysfs) when
uncorrectable error occur.

Required properties:
- compatible: "amazon,al-pcie-external-err".
- reg: The physical base address and length of PCIe controller.
- pcie-port-num: PCIe port number

Optional properties:u
- panic-on-ue: To enable kernel panic when uncorrectable error occur.
```

## Documentation/devicetree/bindings/thermal/al_thermal_v3.txt
```
Annapurna labs alpine V3 thermal sensor management

The alpine V3 contains thermal sensors

Required properties :
- compatible : "annapurna-labs,al-thermal-v3".
- reg : Should contain 1 entry:
- slave_addr : Must contain 1 entry with sbus slave value
- #thermal-sensor-cells : Should be 1. See ./thermal.txt for a description
    of this property.


Example :

	thermal: thermal {
		compatible = "annapurna-labs,al-thermal-v3";
		reg = <0x0 0xfd9c1000 0x0 0x00001000>;
		slave_addr = <6>;
		#thermal-sensor-cells = <1>;
	};

Example: referring to thermal sensors :

	thermal-zones {
		cpu_thermal: cpu-thermal {
			polling-delay-passive = <250>; /* milliseconds */
			polling-delay = <1000>; /* milliseconds */

			thermal-sensors = <&thermal 0>;

			trips {
				cpu_crit: cpu-crit {
					temperature = <105000>; /* millicelsius */
					hysteresis = <2000>; /* millicelsius */
					type = "critical";
				};
			};
		};
```

## Documentation/devicetree/bindings/thermal/thermal_mmio.txt
```
Generic Thermal MMIO sensor management

Generic thermal driver that allows easy connection between
thermal HW to Linux thermal subsystem.

Required properties :
- compatible : "thermal-mmio".
- reg : Should contain 1 entry:
- #thermal-sensor-cells : Should be 1. See ./thermal.txt for a description
    of this property.
- sensors-count : number of sensors in the mmio
- sensor-width : the byte width of each sensor value
- sensor-factor : the multiplication value to be applied on the
   sensor read value in order to represented as millicelsius


Example 1, single sensor, 4 byte value in millicelsius :
	thermal {
		compatible = "thermal-mmio";
		#thermal-sensor-cells = <0x1>;
		reg = <0x0 0xfd8cf104 0x0 0x4>;
		sensors-count = <1>;
		sensor-width = <4>;
		sensor-factor = <1>;
	};

Example 1 : referring to thermal sensor :

	thermal-zones {
		cpu_thermal: cpu-thermal {
			polling-delay-passive = <250>; /* milliseconds */
			polling-delay = <1000>; /* milliseconds */

			thermal-sensors = <&thermal 0>;

			trips {
				cpu_crit: cpu-crit {
					temperature = <105000>; /* millicelsius */
					hysteresis = <2000>; /* millicelsius */
					type = "critical";
				};
			};
		};
	};

Example 2, four sensors with 1 byte value each represented in celsius :

	thermal {
		compatible = "thermal-mmio";
		#thermal-sensor-cells = <0x1>;
		reg = <0x0 0xfd8cf104 0x0 0x4>;
		sensors-count = <4>;
		sensor-width = <1>;
		sensor-factor = <1000>;
	};

Example 2: referring to thermal sensors :

	thermal-zones {
			cpu_thermal: cpu-thermal {
				polling-delay-passive = <250>; /* milliseconds */
				polling-delay = <1000>; /* milliseconds */

				thermal-sensors = <&thermal 0>;

				trips {
					cpu_crit: cpu-crit {
						temperature = <105000>; /* millicelsius */
						hysteresis = <2000>; /* millicelsius */
						type = "critical";
					};
				};
			};

			remote0_thermal: remote0-thermal {
				polling-delay-passive = <250>; /* milliseconds */
				polling-delay = <1000>; /* milliseconds */

				thermal-sensors = <&thermal 1>;

				trips {
					remote0_crit: remote0-crit {
						temperature = <105000>; /* millicelsius */
						hysteresis = <2000>; /* millicelsius */
						type = "critical";
					};
				};
			};

			remote1_thermal: remote1-thermal {
				polling-delay-passive = <250>; /* milliseconds */
				polling-delay = <1000>; /* milliseconds */

				thermal-sensors = <&thermal 2>;

				trips {
					remote1_crit: remote1-crit {
						temperature = <105000>; /* millicelsius */
						hysteresis = <2000>; /* millicelsius */
						type = "critical";
					};
				};
			};

			remote2_thermal: remote2-thermal {
				polling-delay-passive = <250>; /* milliseconds */
				polling-delay = <1000>; /* milliseconds */

				thermal-sensors = <&thermal 3>;

				trips {
					remote2_crit: remote2-crit {
						temperature = <105000>; /* millicelsius */
						hysteresis = <2000>; /* millicelsius */
						type = "critical";
					};
				};
			};
		};
```

## arch/arm/configs/alpine_na_defconfig
```kconfig
# CONFIG_LOCALVERSION_AUTO is not set
CONFIG_SYSVIPC=y
CONFIG_POSIX_MQUEUE=y
CONFIG_FHANDLE=y
CONFIG_NO_HZ=y
CONFIG_HIGH_RES_TIMERS=y
CONFIG_IKCONFIG=y
CONFIG_IKCONFIG_PROC=y
# CONFIG_CGROUPS is not set
CONFIG_BLK_DEV_INITRD=y
CONFIG_EXPERT=y
CONFIG_SYSCTL_SYSCALL=y
CONFIG_SLAB=y
# CONFIG_PROFILING is not set
CONFIG_MODULES=y
CONFIG_MODULE_UNLOAD=y
CONFIG_BLK_DEV_INTEGRITY=y
CONFIG_PARTITION_ADVANCED=y
CONFIG_LDM_PARTITION=y
CONFIG_ARCH_ALPINE=y
CONFIG_ARM_LPAE=y
CONFIG_PCI_IOV=y
CONFIG_PCI_INTERNAL_ALPINE=y
CONFIG_PCI_EXTERNAL_ALPINE=y
CONFIG_SMP=y
CONFIG_AEABI=y
CONFIG_HIGHMEM=y
CONFIG_TRANSPARENT_HUGEPAGE=y
CONFIG_TRANSPARENT_HUGEPAGE_MADVISE=y
CONFIG_VFP=y
CONFIG_NEON=y
# CONFIG_SUSPEND is not set
CONFIG_NET=y
CONFIG_PACKET=y
CONFIG_UNIX=y
# CONFIG_XFRM_USER is not set
CONFIG_NET_KEY=y
CONFIG_INET=y
CONFIG_IP_MULTICAST=y
CONFIG_IP_PNP=y
CONFIG_IP_PNP_BOOTP=y
CONFIG_INET_AH=y
CONFIG_INET_ESP=y
# CONFIG_INET_DIAG is not set
# CONFIG_IPV6 is not set
CONFIG_NETFILTER=y
CONFIG_NF_CONNTRACK=m
CONFIG_NF_CONNTRACK_EVENTS=y
CONFIG_NF_CONNTRACK_FTP=m
CONFIG_NF_CONNTRACK_SIP=m
CONFIG_NF_CT_NETLINK=m
CONFIG_NF_CT_NETLINK_TIMEOUT=m
CONFIG_NF_CONNTRACK_IPV4=m
# CONFIG_NF_CONNTRACK_PROC_COMPAT is not set
CONFIG_NF_NAT_IPV4=m
CONFIG_NF_NAT_MASQUERADE_IPV4=m
CONFIG_IP_NF_IPTABLES=m
CONFIG_IP_NF_FILTER=m
CONFIG_BRIDGE_NF_EBTABLES=m
CONFIG_BRIDGE_EBT_BROUTE=m
CONFIG_BRIDGE_EBT_T_FILTER=m
CONFIG_BRIDGE_EBT_T_NAT=m
CONFIG_BRIDGE_EBT_802_3=m
CONFIG_BRIDGE_EBT_AMONG=m
CONFIG_BRIDGE_EBT_ARP=m
CONFIG_BRIDGE_EBT_IP=m
CONFIG_BRIDGE_EBT_LIMIT=m
CONFIG_BRIDGE_EBT_MARK=m
CONFIG_BRIDGE_EBT_PKTTYPE=m
CONFIG_BRIDGE_EBT_STP=m
CONFIG_BRIDGE_EBT_VLAN=m
CONFIG_BRIDGE_EBT_ARPREPLY=m
CONFIG_BRIDGE_EBT_DNAT=m
CONFIG_BRIDGE_EBT_MARK_T=m
CONFIG_BRIDGE_EBT_REDIRECT=m
CONFIG_BRIDGE_EBT_SNAT=m
CONFIG_BRIDGE_EBT_LOG=m
CONFIG_BRIDGE_EBT_NFLOG=m
CONFIG_BRIDGE=y
CONFIG_VLAN_8021Q=y
CONFIG_DEVTMPFS=y
CONFIG_DEVTMPFS_MOUNT=y
CONFIG_MTD=y
CONFIG_MTD_CMDLINE_PARTS=y
CONFIG_MTD_BLOCK=y
CONFIG_MTD_CFI=y
CONFIG_MTD_CFI_ADV_OPTIONS=y
CONFIG_MTD_CFI_INTELEXT=y
CONFIG_MTD_COMPLEX_MAPPINGS=y
CONFIG_MTD_PHYSMAP_OF=y
CONFIG_MTD_M25P80=y
CONFIG_MTD_BLOCK2MTD=y
CONFIG_MTD_NAND=y
CONFIG_MTD_NAND_AL=y
CONFIG_MTD_SPI_NOR=y
CONFIG_MTD_UBI=y
CONFIG_BLK_DEV_LOOP=y
CONFIG_BLK_DEV_NVME=y
CONFIG_BLK_DEV_RAM=y
CONFIG_RAID_ATTRS=y
CONFIG_BLK_DEV_SD=y
CONFIG_SCSI_SAS_ATTRS=y
CONFIG_SCSI_MPT2SAS=m
CONFIG_ATA=y
# CONFIG_SATA_PMP is not set
CONFIG_SATA_AHCI=y
CONFIG_SATA_AHCI_PLATFORM=y
CONFIG_AHCI_ALPINE=y
CONFIG_SATA_SIL24=m
CONFIG_SATA_MV=y
CONFIG_MD=y
CONFIG_MD_RAID0=y
CONFIG_BLK_DEV_DM=y
CONFIG_DM_CRYPT=y
CONFIG_DM_RAID=y
CONFIG_DM_MULTIPATH=y
CONFIG_DM_UEVENT=y
CONFIG_TARGET_CORE=m
CONFIG_ISCSI_TARGET=m
CONFIG_NETDEVICES=y
CONFIG_BONDING=m
CONFIG_NET_TEAM=m
CONFIG_NET_TEAM_MODE_BROADCAST=m
CONFIG_NET_TEAM_MODE_ROUNDROBIN=m
CONFIG_NET_TEAM_MODE_RANDOM=m
CONFIG_NET_TEAM_MODE_ACTIVEBACKUP=m
CONFIG_NET_TEAM_MODE_LOADBALANCE=m
# CONFIG_TUN is not set
# CONFIG_VHOST_NET is not set
CONFIG_NET_AL_ETH=y
CONFIG_E100=m
CONFIG_E1000=m
CONFIG_E1000E=m
CONFIG_IGB=m
CONFIG_IGBVF=m
CONFIG_IXGBE=m
CONFIG_IXGBEVF=m
CONFIG_AT803X_PHY=y
CONFIG_INPUT_EVDEV=y
# CONFIG_SERIO_SERPORT is not set
CONFIG_SERIO_AMBAKMI=y
CONFIG_LEGACY_PTY_COUNT=16
CONFIG_SERIAL_8250=y
CONFIG_SERIAL_8250_CONSOLE=y
CONFIG_SERIAL_8250_RUNTIME_UARTS=4
CONFIG_SERIAL_8250_EXTENDED=y
CONFIG_SERIAL_8250_MANY_PORTS=y
CONFIG_SERIAL_8250_SHARE_IRQ=y
CONFIG_SERIAL_8250_RSA=y
CONFIG_SERIAL_8250_DW=y
CONFIG_SERIAL_AMBA_PL011=y
CONFIG_SERIAL_AMBA_PL011_CONSOLE=y
CONFIG_SERIAL_OF_PLATFORM=y
CONFIG_HW_RANDOM=y
CONFIG_I2C=y
CONFIG_I2C_CHARDEV=y
CONFIG_I2C_MUX=y
CONFIG_I2C_MUX_PCA954x=y
# CONFIG_I2C_HELPER_AUTO is not set
CONFIG_I2C_DESIGNWARE_PLATFORM=y
CONFIG_SPI=y
CONFIG_SPI_DESIGNWARE=y
CONFIG_SPI_DW_MMIO=y
CONFIG_GPIOLIB=y
CONFIG_GPIO_PL061=y
CONFIG_POWER_SUPPLY=y
CONFIG_POWER_RESET=y
CONFIG_GPIO_SYSFS=y
# CONFIG_HWMON is not set
CONFIG_THERMAL=y
CONFIG_AL_THERMAL=y
CONFIG_WATCHDOG=y
CONFIG_ARM_SP805_WATCHDOG=y
CONFIG_USB=y
CONFIG_USB_XHCI_HCD=y
CONFIG_USB_EHCI_HCD=y
CONFIG_USB_EHCI_HCD_PLATFORM=y
CONFIG_USB_OHCI_HCD=y
CONFIG_USB_STORAGE=y
CONFIG_EDAC=y
CONFIG_EDAC_MM_EDAC=y
CONFIG_EDAC_AL_MC=y
CONFIG_DMADEVICES=y
CONFIG_ASYNC_TX_DMA=y
CONFIG_AL_DMA=y
CONFIG_AL_DMA_STATS=y
CONFIG_AL_DMA_PCI_IOV=y
CONFIG_UIO=y
# CONFIG_IOMMU_SUPPORT is not set
CONFIG_MEMORY=y
CONFIG_EXT2_FS=y
CONFIG_EXT3_FS=y
CONFIG_EXT4_FS=y
# CONFIG_DNOTIFY is not set
# CONFIG_INOTIFY_USER is not set
CONFIG_VFAT_FS=y
CONFIG_TMPFS=y
CONFIG_TMPFS_POSIX_ACL=y
CONFIG_HUGETLBFS=y
CONFIG_CONFIGFS_FS=y
CONFIG_ECRYPT_FS=y
CONFIG_UBIFS_FS=y
CONFIG_CRAMFS=y
CONFIG_MINIX_FS=y
CONFIG_ROMFS_FS=y
CONFIG_NFS_FS=y
CONFIG_ROOT_NFS=y
CONFIG_NFSD=y
CONFIG_NFSD_V3=y
CONFIG_CIFS=y
CONFIG_NLS_CODEPAGE_437=y
CONFIG_NLS_CODEPAGE_850=y
CONFIG_NLS_ISO8859_1=y
# CONFIG_PRINTK_TIME is not set
CONFIG_MESSAGE_LOGLEVEL_DEFAULT=7
# CONFIG_DYNAMIC_DEBUG is not set
# CONFIG_DEBUG_INFO is not set
CONFIG_MAGIC_SYSRQ=y
# CONFIG_ENABLE_DEFAULT_TRACERS is not set
# CONFIG_DEBUG_USER is not set
CONFIG_KEYS=y
CONFIG_ENCRYPTED_KEYS=y
# CONFIG_CRYPTO_MANAGER_DISABLE_TESTS is not set
# CONFIG_CRYPTO_CMAC is not set
# CONFIG_CRYPTO_MD4 is not set
# CONFIG_CRYPTO_ARC4 is not set
CONFIG_CRYPTO_DEV_AL_CRYPTO=y
CONFIG_CRYPTO_DEV_AL_CRYPTO_STATS=y
CONFIG_LIBCRC32C=y
CONFIG_LOCALVERSION="-6.1.3-5851039_na"
# CONFIG_XFS_FS is not set
# CONFIG_DEBUG_KERNEL is not set
CONFIG_NET_MQ_TX_LOCK_OPT=y
# CONFIG_VIRTUALIZATION is not set
# CONFIG_KVM is not set
# CONFIG_CAIF is not set
# CONFIG_CAIF_VIRTIO is not set
# CONFIG_CC_STACKPROTECTOR is not set
CONFIG_NETFILTER_ADVANCED=y
CONFIG_PERF_EVENTS=y
CONFIG_JUMP_LABEL=y
CONFIG_FUNC_REORDER=y
CONFIG_HIGHPTE=y
CONFIG_BQL=n
CONFIG_NET_FLOW_LIMIT=n
```

## arch/arm/mach-alpine/Kconfig
```kconfig
config ARCH_ALPINE
	bool "Annapurna Labs Alpine platform" if ARCH_MULTI_V7
	select ARM_AMBA
	select ARM_GIC
	select GENERIC_IRQ_CHIP
	select GENERIC_MSI_IRQ_DOMAIN
	select HAVE_ARM_ARCH_TIMER
	select HAVE_SMP
	select IRQ_DOMAIN_HIERARCHY
	select MFD_SYSCON
	select PCI
	select PCI_DOMAINS
	select PCI_MSI
	select PCI_MSI_IRQ_DOMAIN
	select POWER_RESET_ALPINE
	select ARCH_DMA_ADDR_T_64BIT if ARM_LPAE
	select ARCH_LONG_LONG_ATOMIC
	help
	  This enables support for the Annapurna Labs Alpine V1 boards.
```
